/*

Copyright (C) David W. Vernooy

This program is free software; you can redistribute it and/or
modify it under the terms of the GNU General Public License
as published by the Free Software Foundation; either version 2
of the License, or (at your option) any later version.

This program is distributed in the hope that it will be useful,
but WITHOUT ANY WARRANTY; without even the implied warranty of
MERCHANTABILITY or FITNESS FOR A PARTICULAR PURPOSE.  See the
GNU General Public License for more details.

You should have received a copy of the GNU General Public License
along with this program; if not, write to the Free Software
Foundation, Inc., 51 Franklin Street, Fifth Floor, Boston, MA  02110-1301, USA.
*/

#include <stdio.h>
#include <avr/io.h>
#include <avr/pgmspace.h>
#include <avr/interrupt.h>
#include <util/delay.h>
#include "lcd.h"

/* Command type sent to the lcd */
typedef enum { LCD_CMD  = 0, LCD_DATA = 1 } LcdCmdData;


/* declarations */
void lcd_base_addr(uint16_t addr);
void lcd_send(uint8_t data, LcdCmdData cd);


/* flag to invert text */
uint8_t invert = 0;

/* current position of lcd */
int lcd_current_position;

/* Alphabet lookup */
unsigned char PROGMEM font5x7 [][5] = {
	{ 0x00, 0x00, 0x00, 0x00, 0x00 },   // sp
    { 0x00, 0x00, 0x2f, 0x00, 0x00 },   // !
    { 0x00, 0x07, 0x00, 0x07, 0x00 },   // "
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    { 0x44, 0x64, 0x54, 0x4C, 0x44 },   // z
   };




/* Performs IO & LCD controller initialization */
void lcd_init(void)
{
    // Pull-up on reset pin
    LCD_PORT |= LCD_RST_PIN;
	
	// Set output bits on lcd port
	LCD_DDR |= LCD_RST_PIN | LCD_CE_PIN | LCD_DC_PIN | LCD_DATA_PIN | LCD_CLK_PIN;
    
	// Wait for reset (max 30ms)
    _delay_ms(15);
    
    // Toggle reset pin
    LCD_PORT &= ~LCD_RST_PIN;
  
  //  lcd_delay();
   _delay_ms(15);
  
  LCD_PORT |= LCD_RST_PIN;

    // Disable controller
    LCD_PORT |= LCD_CE_PIN;

    lcd_send(0x21, LCD_CMD);  // Extended Command set
    lcd_send(0xC8, LCD_CMD);  // Set Contrast
    lcd_send(0x06, LCD_CMD);  // Set Tempco
    lcd_send(0x13, LCD_CMD);  // LCD bias mode 1:48
    lcd_send(0x20, LCD_CMD);  // Horizontal address, std commands
    lcd_send(0x0C, LCD_CMD);  // normal mode
    
    // Clear lcd
    lcd_clear();
	
}

/* Contrast */
void lcd_contrast(uint8_t contrast)
{
	lcd_send(0x21, LCD_CMD);				// LCD Extended Commands
    lcd_send(0x80 | contrast, LCD_CMD);		// Set LCD Vop(Contrast)
    lcd_send(0x20, LCD_CMD);				// LCD std cmds, hori addr mode
}

/* Clears the display */
void lcd_clear(void)
{
	lcd_current_position = 0;
	lcd_base_addr(lcd_current_position);
	
    // Set the entire cache to zero and write 0s to lcd
    for(int i=0;i<LCD_TOTAL;i++) {
		lcd_send(0, LCD_DATA);
    }
}

/* Sets cursor location to xy location corresponding to basic font size */
void lcd_goto_xy(uint8_t x, uint8_t y)
{
    lcd_current_position = (x-1)*6 + (y-1)*84;
}


/* Displays a character at current cursor location */
void lcd_chr(char chr)
{
	lcd_base_addr(lcd_current_position);

    // 5 pixel wide characters and add space
    for(uint8_t i=0;i<5;i++) {
		lcd_send(pgm_read_byte(&font5x7[chr-32][i]) << 1, LCD_DATA);
    }
	lcd_send(0, LCD_DATA);
	
	lcd_current_position += 6;
}


// Set the base address of the lcd
void lcd_base_addr(uint16_t addr) {
	lcd_send(0x80 |(addr % LCD_X_DIMENSION), LCD_CMD);
	lcd_send(0x40 |(addr / LCD_X_DIMENSION), LCD_CMD);
}

/* Sends data to display controller */
void lcd_send(uint8_t data, LcdCmdData cd)
{
	// Data/DC are outputs for the lcd (all low)
	LCD_DDR |= LCD_DATA_PIN | LCD_DC_PIN;
	
    // Enable display controller (active low)
    LCD_PORT &= ~LCD_CE_PIN;

    // Either command or data
    if(cd == LCD_DATA) {
		//if text invert on
		if (invert) data = ~data;
        LCD_PORT |= LCD_DC_PIN;
    } else {
        LCD_PORT &= ~LCD_DC_PIN;
    }
	
	for(uint8_t i=0;i<8;i++) {
	
		// Set the DATA pin value
		if((data>>(7-i)) & 0x01) {
			LCD_PORT |= LCD_DATA_PIN;
		} else {
			LCD_PORT &= ~LCD_DATA_PIN;
		}
		
		// Toggle clock
		LCD_PORT |= LCD_CLK_PIN;
		LCD_PORT &= ~LCD_CLK_PIN;
	}

	// Disable display control
    LCD_PORT |= LCD_CE_PIN;
	
	// Data/DC can be reused
	LCD_DDR &= ~(LCD_DATA_PIN | LCD_DC_PIN);
	LCD_PORT |= LCD_DATA_PIN | LCD_DC_PIN;
}

// Called by printf as a stream handler
int lcd_chr_printf(char var, FILE *stream) {
	lcd_chr(var);
	return 0;
}